## firmware/main/Kconfig.projbuild
```kconfig
menu "Now Playing"

    config NP_WIFI_SSID
        string "Wi-Fi SSID"
        default ""

    config NP_WIFI_PASSWORD
        string "Wi-Fi password"
        default ""

    config NP_HOSTNAME
        string "mDNS hostname (without .local)"
        default "nowplaying"

    config NP_TOKEN
        string "X-Token shared with the phone"
        default ""
        help
            Every POST request must carry this value in the X-Token header.
            When empty, POST requests are refused.

    config NP_MAX_JPEG_KB
        int "Maximum JPEG size (KB)"
        default 512
        range 64 2048

    config NP_DIAG_SCREEN
        bool "Diagnostic screen at boot"
        default y
        help
            From boot until the first image, show the reset reason, the Wi-Fi state, the
            HTTP server state, the last request and the latest log lines. Touching the
            screen shows or hides it at any time, whatever this option says.

    config NP_DIAG_SECONDS
        int "Hide the boot diagnostic screen after (seconds, 0: never)"
        depends on NP_DIAG_SCREEN
        default 600
        range 0 86400

endmenu
```
